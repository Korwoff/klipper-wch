## src/ch32v/Kconfig
```kconfig
# Kconfig settings for WCH CH32V processors

if MACH_CH32V

config CH32V_SELECT
    bool
    default y
    select HAVE_GPIO
    select HAVE_GPIO_ADC
    select HAVE_GPIO_SPI
    select HAVE_GPIO_I2C
    select HAVE_GPIO_HARD_PWM
    select HAVE_STRICT_TIMING
    select HAVE_CHIPID
    select HAVE_BOOTLOADER_REQUEST
    select HAVE_LIMITED_CODE_SIZE if FLASH_SIZE < 0x10000

config BOARD_DIRECTORY
    string
    default "ch32v"

######################################################################
# Chip selection
######################################################################

choice
    prompt "Processor model"
    config MACH_CH32V005
        bool "CH32V005"
        select MACH_CH32V00x
    config MACH_CH32V203
        bool "CH32V203"
        select MACH_CH32V20x
endchoice

config MACH_CH32V00x
    bool
config MACH_CH32V20x
    bool

config MACH_CH32V203x6
    depends on LOW_LEVEL_OPTIONS && MACH_CH32V203
    bool "Only 32KiB flash / 10KiB RAM (CH32V203x6 variant)"

config HAVE_CH32V_USBFS
    bool
    default y if MACH_CH32V20x

config MCU
    string
    default "ch32v005" if MACH_CH32V005
    default "ch32v203x6" if MACH_CH32V203x6
    default "ch32v203" if MACH_CH32V203

config CLOCK_FREQ
    int
    default 48000000 if MACH_CH32V005
    default 72000000 if MACH_CH32V203 && CH32V_CLOCK_REF_INTERNAL
    default 144000000 if MACH_CH32V203

config FLASH_SIZE
    hex
    default 0x8000 if MACH_CH32V005 || MACH_CH32V203x6
    default 0x10000 if MACH_CH32V203

config FLASH_BOOT_ADDRESS
    hex
    default 0x00000000

config FLASH_APPLICATION_ADDRESS
    hex
    default 0x00000000

config RAM_START
    hex
    default 0x20000000

config RAM_SIZE
    hex
    default 0x1800 if MACH_CH32V005
    default 0x2800 if MACH_CH32V203x6
    default 0x5000 if MACH_CH32V203

config STACK_SIZE
    int
    default 512 if MACH_CH32V005 || MACH_CH32V203

######################################################################
# Clock
######################################################################

choice
    prompt "Clock Reference" if LOW_LEVEL_OPTIONS
    config CH32V_CLOCK_REF_8M
        bool "8 MHz crystal" if MACH_CH32V20x
    config CH32V_CLOCK_REF_24M
        bool "24 MHz crystal"
    config CH32V_CLOCK_REF_INTERNAL
        bool "Internal clock"
endchoice
config CLOCK_REF_FREQ
    int
    default 24000000 if CH32V_CLOCK_REF_24M
    default 8000000 if CH32V_CLOCK_REF_8M
    default 1 if CH32V_CLOCK_REF_INTERNAL
    default 1 if MACH_CH32V005
    default 8000000

######################################################################
# Communication interface
######################################################################

choice
    prompt "Communication interface"
    config CH32V_SERIAL_USART1
        bool "Serial (on USART1 PA10/PA9)"
        select SERIAL
    config CH32V_SERIAL_USART1_ALT_PB7_PB6
        bool "Serial (on USART1 PB7/PB6)" if LOW_LEVEL_OPTIONS && MACH_CH32V20x
        select SERIAL
    config CH32V_SERIAL_USART2
        bool "Serial (on USART2 PA3/PA2)" if LOW_LEVEL_OPTIONS && (MACH_CH32V20x || MACH_CH32V00x)
        select SERIAL
    config CH32V_SERIAL_USART3
        bool "Serial (on USART3 PB11/PB10)" if LOW_LEVEL_OPTIONS && MACH_CH32V20x
        select SERIAL
    config CH32V_SERIAL_UART4
        bool "Serial (on UART4 PC11/PC10)" if LOW_LEVEL_OPTIONS && MACH_CH32V20x
        select SERIAL
    config CH32V_USB_PA11_PA12
        bool "USB (on PA11/PA12)" if HAVE_CH32V_USBFS
        select USBSERIAL
    config CH32V_USBCANBUS_PA11_PA12
        bool "USB to CAN bus bridge (USB on PA11/PA12)" if HAVE_CH32V_USBFS
        select USBCANBUS
    config CH32V_MMENU_CANBUS_PA11_PA12
        bool "CAN bus (on PA11/PA12)" if MACH_CH32V20x
        select CANSERIAL
    config CH32V_MMENU_CANBUS_PB8_PB9
        bool "CAN bus (on PB8/PB9)" if LOW_LEVEL_OPTIONS && MACH_CH32V20x
        select CANSERIAL
endchoice

choice
    prompt "CAN bus interface" if USBCANBUS
    config CH32V_CMENU_CANBUS_PB8_PB9
        bool "CAN bus (on PB8/PB9)"
endchoice

config CH32V_CANBUS_PA11_PA12
    bool
    default y if CH32V_MMENU_CANBUS_PA11_PA12
config CH32V_CANBUS_PB8_PB9
    bool
    default y if CH32V_MMENU_CANBUS_PB8_PB9 || CH32V_CMENU_CANBUS_PB8_PB9

endif
```
